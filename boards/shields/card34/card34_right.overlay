#include "card34.dtsi"

/ {
    chosen {
        zmk,kscan = &kscan0;
    };

    kscan0: kscan {
        compatible = "zmk,kscan-gpio-matrix";
        diode-direction = "col2row";
        wakeup-source;

        row-gpios =
            <&xiao_d 10 (GPIO_ACTIVE_HIGH | GPIO_PULL_DOWN)>, /* row 0 */
            <&xiao_d 9  (GPIO_ACTIVE_HIGH | GPIO_PULL_DOWN)>, /* row 1 */
            <&xiao_d 8  (GPIO_ACTIVE_HIGH | GPIO_PULL_DOWN)>, /* row 2 */
            <&xiao_d 7  (GPIO_ACTIVE_HIGH | GPIO_PULL_DOWN)>; /* row 3 */

        col-gpios =
            <&xiao_d 4 GPIO_ACTIVE_HIGH>, /* col 5: Y H N */
            <&xiao_d 3 GPIO_ACTIVE_HIGH>, /* col 4: U J M */
            <&xiao_d 2 GPIO_ACTIVE_HIGH>, /* col 3: I K , */
            <&xiao_d 1 GPIO_ACTIVE_HIGH>, /* col 2: O L . */
            <&xiao_d 0 GPIO_ACTIVE_HIGH>; /* col 1: P ; / */
    };
};

&default_transform {
    col-offset = <5>;
};
