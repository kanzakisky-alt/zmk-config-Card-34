/ {
    chosen {
        zmk,kscan = &kscan0;
    };

    kscan0: kscan_gpio_matrix {
        compatible = "zmk,kscan-gpio-matrix";
        label = "KSCAN";
        diode-direction = "col2row";

        row-gpios
            = <&xiao_d 10 (GPIO_ACTIVE_HIGH | GPIO_PULL_DOWN)>
            , <&xiao_d  9 (GPIO_ACTIVE_HIGH | GPIO_PULL_DOWN)>
            , <&xiao_d  8 (GPIO_ACTIVE_HIGH | GPIO_PULL_DOWN)>
            , <&xiao_d  7 (GPIO_ACTIVE_HIGH | GPIO_PULL_DOWN)>
            ;
    };
};
