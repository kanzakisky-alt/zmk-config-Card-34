## boards/shields/card34/Kconfig.defconfig
```kconfig
if SHIELD_CARD34_LEFT || SHIELD_CARD34_RIGHT

config ZMK_KEYBOARD_NAME
    default "Card 34"

endif
```

## boards/shields/card34/Kconfig.shield
```kconfig
config SHIELD_CARD34_LEFT
    def_bool $(shields_list_contains,card34_left)
    select ZMK_SPLIT_ROLE_CENTRAL

config SHIELD_CARD34_RIGHT
    def_bool $(shields_list_contains,card34_right)
```
